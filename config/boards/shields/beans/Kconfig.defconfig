## config/boards/shields/beans/Kconfig.defconfig
```kconfig
# Copyright (c) 2020 The ZMK Contributors
# SPDX-License-Identifier: MIT

if SHIELD_beans_LEFT

config ZMK_KEYBOARD_NAME
    default "beans"

config ZMK_SPLIT_ROLE_CENTRAL
    default y

endif

if SHIELD_beans_LEFT || SHIELD_beans_RIGHT

config ZMK_SPLIT
    default y

endif
```

## config/boards/shields/beans/Kconfig.shield
```kconfig
# Copyright (c) 2020 The ZMK Contributors
# SPDX-License-Identifier: MIT

config SHIELD_beans_LEFT
    def_bool $(shields_list_contains,beans_left)

config SHIELD_beans_RIGHT
    def_bool $(shields_list_contains,beans_right)
```
